#include "shapekey_test.dtsi" // The shared dtsi file is included in the overlay

// Label of the kscan node in the dtsi
&kscan0 {
    col-gpios
        = <&xiao_d  6 GPIO_ACTIVE_HIGH>
        , <&xiao_d  9 GPIO_ACTIVE_HIGH>
        , <&xiao_d  7 GPIO_ACTIVE_HIGH>
        ;
};