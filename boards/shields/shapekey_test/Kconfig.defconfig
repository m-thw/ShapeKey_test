## boards/shields/shapekey_test/Kconfig.defconfig
```kconfig
if SHAPEKEY_TEST

# Name must be less than 16 characters long!
config ZMK_KEYBOARD_NAME
    default "shapekey_test"

endif
```

## boards/shields/shapekey_test/Kconfig.shield
```kconfig
# No whitespace after the comma or in your keyboard name!
config SHAPEKEY_TEST
    def_bool $(shields_list_contains,s)
```
